/*   .*""""""""""""""""""""""*.
     :                          ;
     :                          ;
     :  ......................  ;
     : :                      ; ;
     :_:                      ;_;
    /  :  __...--------...__  ;  \
   /   :"'  .*"*-.  .-*"*.  '";   \
  :    ;   /      ;:      \   :    ;
  !    !  ;    *  !!  *    :  !    !
  ;   ;   :     .'  '.     ;   ;   :
  :  .'    '-.-'      '-.-'    '.  ;
  '-"\                          /"-'
      '.                      .'
        *,      '-__-'      ,*
        /.'-_            _-' .\
     /  "-_"*-.____.-*" _-"  \
    /      '-_  /'\  _-'      \
     :    :   __'" | "'__   ;    ;
     |.--.;  |\/|  |  |\/|  :.--.|
     (   ()  |__|  |  |__|  ()   )
      '--^_        |        _^--'
         | "'*--.._I_..--*'" |
         | __..._  | _..._   |
        .'"      `"'"     ''"'.
        """""""""""""""""""""""
                K Y L E 
*/

int n;

void setup() {
  Serial.begin(9600);
  Serial.print("saisir un temps (s): ");
}

void loop() 
{
  if (Serial.available()) 
  {
  n = Serial.parseInt();
  if (n>10)
  {
    for (; n>10; n-=10)
    {
       delay(10000);
       Serial.print(n); 
    }
  }
    
    if (n<10)
    {
     for (; n<10; n--) 
    {
     Serial.println(n);
     delay(1000);
    }
     if (n == 0) 
        {
         Serial.println("go");
        }
    }
  }
}
